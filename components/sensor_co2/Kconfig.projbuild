## components/sensor_co2/Kconfig.projbuild
```kconfig
menu "AQS CO2 Sensor"

    config I2C_SCD40_ADDRESS
        hex "I2C SCD40 ADDRESS"
        default 0x62
        help
            Address of I2C slave device SCD40 sensor
    
    config CO2_MEASUREMENT_FREQ_SECONDS
        int "CO2 Measure request frequency in SECONDS"
        default 5
        help
            How long should we wait before getting next measurement. Default 5 sec, cannot be less!

    config CO2_LED_UPDATE_FREQ_SECONDS
        int "CO2 LED update frequency in SECONDS"
        default 5
        help
            How long should we wait before update the LED colour with new CO2 severity level. Shold not be less than CO2 measurement frequency.

endmenu
```

## components/sensor_temp/Kconfig.projbuild
```kconfig
menu "AQS Temperature, humidity sensor"
        
    config BME680_I2C_ADDR_0
        hex "I2C BME680 ADDRESS"
        default 0x76
        help
            Address of I2C BME680 sensor
    
    config BME680_I2C_ADDR_1
        hex "I2C BME680 ADDRESS"
        default 0x77
        help
            Address of I2C BME680 sensor

    config BME680_MEASUREMENT_FREQ_SECONDS
        int "Measure request frequency in SECONDS"
        default 5
        help
            How long should we wait before getting next measurement. Default 5 sec, cannot be less!

endmenu
```
