## components/a_menu/Kconfig.projbuild
```kconfig
menu "AQS Project Configurations"

    comment "This is separate section for project configuration"

endmenu
```

## components/battery_driver/Kconfig.projbuild
```kconfig
menu "AQS ADC Battery"

    config ADC_PIN
        int "ADC Pin"
        default 0 if IDF_TARGET_ESP32C6
        default 0
        help
            ADC Pin where is battery voltage pin attached AFTER resistors!
    
    config ADC_MEASUREMENT_LOOP_COUNT
        int "Times to take one shot mesure"
        default 5
        help
            How many times to check ADC one shot read in one go
    
    config ADC_MEASUREMENT_FREQ_MINUTES
        int "Voltage Measure request frequency minues"
        default 1
        help
            How long should we wait before getting next measurement. Default 1 minute!

    config BATTERY_CHARGED_VOLTAGE
        int "Voltage of fully charged battery"
        default 2590
        help
            This this the voltage of 18650 cell measured between 100k and 10k resistors.

    config BATTERY_DISCHARGED_VOLTAGE
        int "Voltage of fully discharged battery"
        default 2100
        help
            This this the voltage of 18650 cell measured between 100k and 10k resistors.

endmenu
```

## components/captive_portal/Kconfig.projbuild
```kconfig
menu "AQS Captive Portal"

    config USE_CAPTIVE_PORTAL
        bool "Use captive portal"
        default y
        help 
            Start captive portal with DNS and mobile redirection at WiFI client connection

endmenu
```

## components/card_driver/Kconfig.projbuild
```kconfig
menu "3. AQS SD Card"

    menu "Configuration"

        config SD_GPIO_MOSI
            int "SD Card MOSI Pin"
            default 6 if IDF_TARGET_ESP32C6
            help
                Same as in LCD config MOSI, leave empty for default.

        config SD_GPIO_SCLK
            int "SD Card SCLK Pin"
            default 7 if IDF_TARGET_ESP32C6
            help
                Same as in LCD config SCLK, leave empty for default.

        config SD_GPIO_MISO
            int "SD Card MISO Pin"
            default 5 if IDF_TARGET_ESP32C6
            default 5
            help
                Default according to Waveshare board with LCD.

        config SD_GPIO_CS
            int "SD Card CS Pin"
            default 4 if IDF_TARGET_ESP32C6
            default 4
            help
                Default according to Waveshare board with LCD.

        config SD_MOUNT_POINT
            string "SD FAT Mount Point"
            default "/sdcard"
            help
                How to name a mount point

        config FORMAT_IF_MOUNT_FAILED
            bool "Format if mount failed"
            default y
        config FORMAT_AT_MOUNT
            bool "Format at mount - each power cycle"
            default n

    endmenu

endmenu
```

## components/display_driver/Kconfig.projbuild
```kconfig
menu "AQS LCD Display"

    choice LCD_CONNECTION_TYPE
        prompt "LCD Connection type: 4 pin I2C 6 pin SPI"
        default CONNECTION_SPI
        help
            Select LCD connection type, i2c will use common pins

        config CONNECTION_SPI
            bool "SPI 6 pin"
            help
                Setup similar to Waveshare esp32c6 LCD Datasheet

        config CONNECTION_I2C
            bool "I2C 4 pin (common i2c master pins)"
            help
                See AQS I2C Master Bus config

    endchoice

    config DISP_I2C_ADR
        depends on CONNECTION_I2C
        hex "LCD I2C Address"
        default 0x3C if IDF_TARGET_ESP32C6
        default 0x3C
        help
            Display i2c address

    config DISPL_BACKLIT_BRIGHTNESS
        depends on CONNECTION_SPI
        int "Brightness of LCD display backlight"
        range 0 100
        default 50
        help
            From 0 to 100

    config DISP_GPIO_SCLK
        depends on CONNECTION_SPI
        int "SCLK"
        default 7 if IDF_TARGET_ESP32C6
        default 7
        help
            Display pin SCLK (also used in SD card)
    config DISP_GPIO_MOSI
        depends on CONNECTION_SPI
        int "MOSI"
        default 6 if IDF_TARGET_ESP32C6
        default 6
        help
            Display pin MOSI (also used in SD card)
    config DISP_GPIO_RST
        depends on CONNECTION_SPI
        int "RST"
        default 21 if IDF_TARGET_ESP32C6
        default 21
        help
            Display pin RST
    config DISP_GPIO_DC
        depends on CONNECTION_SPI
        int "DC"
        default 15 if IDF_TARGET_ESP32C6
        default 15
        help
            Display pin DC
    config DISP_GPIO_CS
        depends on CONNECTION_SPI
        int "CS"
        default 14 if IDF_TARGET_ESP32C6
        default 14
        help
            Display pin CS
    config DISP_GPIO_BL
        depends on CONNECTION_SPI
        int "BL"
        default 22 if IDF_TARGET_ESP32C6
        default 22
        help
            Display pin BL

endmenu
```

## components/i2c_driver/Kconfig.projbuild
```kconfig
menu "AQS I2C Master Bus"

    config COMMON_SDA_PIN
        int "SDA GPIO Num"
        default 18 if IDF_TARGET_ESP32C6
        default 0
        help
            SDA Pin - common for multiple sensors.
    
    config COMMON_SCL_PIN
        int "SCL GPIO Num"
        default 3 if IDF_TARGET_ESP32C6
        default 3
        help
            ADC attenuation parameter. Different parameters determine the range of the ADC.

    config I2C_FREQ_HZ
        int "Master Frequency"
        default 100000
        help
            I2C Speed of Master device. 100k usual.

endmenu
```

## components/led_driver/Kconfig.projbuild
```kconfig
menu "AQS LED strip"

    config LED_STRIP_GPIO_PIN
        int "Led strip pin"
        default 8
        help
            GPIO number for board LED or extra LED.

    choice COLOUR_COMPONENT_FORMAT
        prompt "LED colours ordering"
        default FMT_RGB
        help
            Select proper order for LED colour RGB/GRB

        config FMT_RGB
            bool "RGB"
        config FMT_GRB
            bool "GRB"
    endchoice

    config LED_COLOUR_SATURATION
        int "saturation part of color (0 - 255, rescaled from 0 - 1. e.g. saturation = 0.5, rescaled to 127)"
        range 0 255
        default 255

    config LED_COLOUR_VALUE
        int "value part of color (0 - 255, rescaled from 0 - 1. e.g. value = 0.5, rescaled to 127)"
        range 0 255
        default 255

endmenu
```

## components/littlefs_driver/Kconfig.projbuild
```kconfig
menu "2. AQS LittleFS"

    menu "Configuration"
        config LFS_MOUNT_POINT
            string "LittleFS Mount Point"
            default "/littlefs"
            help
                How to name a mount point
        config LFS_PARTITION_NAME
            string "LittleFS Partition Name"
            default "littlefs"
            help
                How to name a partition
    endmenu

endmenu
```

## components/lvgl_driver/Kconfig.projbuild
```kconfig
menu "AQS LVGL Graphics"

    choice DISPLAY_ROTATION
        prompt "Select display rotation degree 0 90 180 270"
        default ROTATE_0
        help
            Select LCD panel graphics rotation
        config ROTATE_0
            bool "No rotation 0 deg"
        config ROTATE_90
            bool "Rotate display 90 deg"
        config ROTATE_180
            bool "Rotate display 180 deg"
        config ROTATE_270
            bool "Rotate display 270 deg"
    endchoice

    config DISPLAY_UPDATE_FREQ
        int "How often redraw display with new data from sensors"
        default 1
        help
            How often redraw display with new data from sensors in seconds.

endmenu
```

## components/webserver/Kconfig.projbuild
```kconfig
menu "AQS WebServer"

    config USERNAME
        string "Admin user"
        default "admin"
        help
            User for auth

    config PASSWORD
        string "Admin Password"
        default "mypassword"
        help
            Password for auth

    config BASIC_AUTH
        int "Basic Auth"
        default 0
        help
            Use Admin login

endmenu
```
